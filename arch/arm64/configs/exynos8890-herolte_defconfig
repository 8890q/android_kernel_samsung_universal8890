## arch/arm64/mach-exynos/Kconfig
```kconfig
# arch/arm64/mach-exynos/Kconfig
#
# Copyright (c) 2016 Samsung Electronics Co., Ltd.
#		http://www.samsung.com/
#
# Licensed under GPLv2

# Configuration options for the EXYNOS8

if ARCH_EXYNOS

menu "SAMSUNG EXYNOS SoCs Support"

config SKIP_HW_BREAKPOINT
	bool "support skip hw breakpoint"
	default n
	help
	  Support early param for T32 onchip breakpoint

choice
	prompt "Exynos device target"
	default MACH_EXYNOS8895_NONE

config MACH_EXYNOS8895_NONE
	bool "None"

config MACH_EXYNOS8895_DREAMLTE_EUR_OPEN
	bool "Galaxy S8 (SM-G950F)"
	select EXYNOS_DTBTOOL

config MACH_EXYNOS8895_DREAM2LTE_EUR_OPEN
	bool "Galaxy S8+ (SM-G955F)"
	select EXYNOS_DTBTOOL

config MACH_EXYNOS8895_GREATLTE_EUR_OPEN
	bool "Galaxy Note8 (SM-N950F)"
	select EXYNOS_DTBTOOL

config MACH_EXYNOS8895_DREAMLTE_KOR
	bool "Galaxy S8 (SM-G950N)"
	select EXYNOS_DTBTOOL

config MACH_EXYNOS8895_DREAM2LTE_KOR
	bool "Galaxy S8+ (SM-G955N)"
	select EXYNOS_DTBTOOL

config MACH_EXYNOS8895_GREATLTE_KOR
	bool "Galaxy Note8 (SM-N950N)"
	select EXYNOS_DTBTOOL

config MACH_EXYNOS8890_HEROLTE_EUR_OPEN
	bool "Galaxy S7 (SM-G930F, Exynos 8890)"
	depends on SOC_EXYNOS8890
	select EXYNOS_DTBTOOL
	select PWRCAL

endchoice

endmenu

endif
```

## drivers/gpu/arm/t8xx/Kconfig
```kconfig
config MALI_T8XX
	bool "Mali T8xx support"
	depends on SOC_EXYNOS8890
	default y

config MALI_R28P0
	bool "Mali R28P0 driver"
	depends on MALI_T8XX
	select MALI_MIDGARD
	default y

if MALI_R28P0
source "drivers/gpu/arm/t8xx/r28p0/Kconfig"
endif
```

## drivers/gud/Kconfig
```kconfig
#
# Mobicore Configuration
#

if SOC_EXYNOS8895
source "drivers/gud/gud-exynos8895_kinibi400/Kconfig"
endif

if SOC_EXYNOS8890
source "drivers/gud/gud-exynos8890/Kconfig"
endif
```

## drivers/motor/Kconfig
```kconfig
config MOTOR_DRV_MAX77854
	tristate "Maxim MAX77854 motor"
	default n
	depends on (MFD_MAX77854 && ANDROID_TIMED_OUTPUT)
	help
	  If you say yes here you will get support for the
	  motor of Maxim MAX77854 PMIC.

config MOTOR_DRV_MAX77865
	tristate "Maxim MAX77854 motor"
	default n
	depends on (MFD_MAX77865 && ANDROID_TIMED_OUTPUT)
	help
	  If you say yes here you will get support for the
	  motor of Maxim MAX77865 PMIC.
	  
config MOTOR_DRV2624
	tristate "motor"
	default n
	help
	  Say Y to enable MOTOR DRV2624.

config MOTOR_DRV_SENSOR
	bool "MAX77854 motor feedback to sensor hub"
	depends on MOTOR_DRV_MAX77854 && SSP_MOTOR
```

## drivers/switch/Kconfig
```kconfig
menuconfig SWITCH
	tristate "Switch class support"
	help
	  Say Y here to enable switch class support. This allows
	  monitoring switches by userspace via sysfs and uevent.

if SWITCH

config SWITCH_GPIO
	tristate "GPIO Swith support"
	depends on GPIOLIB
	help
	  Say Y here to enable GPIO based switch support.

config SWITCH_MADERA
	tristate "Cirrus Logic Madera codec support"
	depends on MFD_MADERA && INPUT && SND_SOC
	help
	  Say Y here to enable support for external accessory detection
	  on Cirrus Logic Madera class codecs.

endif # SWITCH

config SWITCH_ARIZONA
	tristate "Wolfson Arizona Switch support"
	depends on SWITCH && MFD_ARIZONA && INPUT && SND_SOC
	help
	  Say Y here to enable support for external accessory detection
	  with Wolfson Arizona devices. These are audio CODECs with
	  advanced audio accessory detection support.
```

## drivers/video/fbdev/exynos/Kconfig
```kconfig
#
# Exynos Video configuration
#

menuconfig EXYNOS_VIDEO
	bool "Exynos Video driver support"
	depends on ARCH_S5PV210 || ARCH_EXYNOS
	help
	  This enables support for EXYNOS Video device.

if EXYNOS_VIDEO

#
# MIPI DSI driver
#

if !SOC_EXYNOS8890

config EXYNOS_MIPI_DSI
	bool "EXYNOS MIPI DSI driver support."
	select GENERIC_PHY
	help
	  This enables support for MIPI-DSI device.

config EXYNOS_LCD_S6E8AX0
	bool "S6E8AX0 MIPI AMOLED LCD Driver"
	depends on EXYNOS_MIPI_DSI && BACKLIGHT_CLASS_DEVICE
	depends on (LCD_CLASS_DEVICE = y)
	default n
	help
	  If you have an S6E8AX0 MIPI AMOLED LCD Panel, say Y to enable its
	  LCD control driver.

endif # !SOC_EXYNOS8890

if SOC_EXYNOS8890
source "drivers/video/fbdev/exynos/decon_8890/Kconfig"
endif

config EXYNOS_DUAL_DISPLAY
	bool "EXYNOS Dual Display Driver Support."
	depends on SOC_EXYNOS8895
	default n

config EXYNOS_SINGLE_DISPLAY
	bool "EXYNOS Single Display Driver Support."
	depends on SOC_EXYNOS8895
	default y

if SOC_EXYNOS8895
if EXYNOS_SINGLE_DISPLAY
source "drivers/video/fbdev/exynos/dpu/Kconfig"
source "drivers/video/fbdev/exynos/panel/Kconfig"
endif # EXYNOS_SINGLE_DISPLAY
if EXYNOS_DUAL_DISPLAY
source "drivers/video/fbdev/exynos/dual_dpu/Kconfig"
source "drivers/video/fbdev/exynos/dual_panel/Kconfig"
endif #EXYNOS_DUAL_DISPLAY
endif # SOC_EXYNOS8895
endif # EXYNOS_VIDEO
```
